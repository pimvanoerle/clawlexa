## firmware/main/Kconfig.projbuild
```kconfig
menu "clawlexa"

config CLAWLEXA_HEADLESS
    bool "Headless mode (skip display/touch bring-up)"
    default n
    help
        Skip peripheral (display, touch) initialization in app_main. Intended
        for emulation (QEMU) or host CI where the LCD/touch hardware is absent
        and their init would abort. The boot banner and heartbeat still run, so
        the core boot path can be smoke-tested without a board.

        Leave disabled (n) for real-hardware builds.

config CLAWLEXA_MIC_DUMP_ON_BOOT
    bool "Dump a mic recording over serial on boot"
    default n
    help
        Record a few seconds from the mic at boot and dump it as base64 over the
        console for tools/capture_mic.py. Off by default — it floods the console
        on every boot. Enable it (or build a dedicated capture image) when you
        want to grab a recording; mic_init() runs regardless.

config CLAWLEXA_BOOT_CHIME
    bool "Play the boot chime through the speaker on boot"
    default n
    help
        Play the embedded boot.wav through the speaker at startup. Off by default
        to keep boot quiet. audio_play_init() runs regardless, so the speaker
        still works for bridge replies.

config CLAWLEXA_WIFI_SSID
    string "WiFi SSID"
    default ""
    help
        SSID of the WiFi network to join (station mode). Set this in your local
        sdkconfig via `idf.py menuconfig` — it is gitignored, so credentials
        never get committed. Empty = no connection attempt.

config CLAWLEXA_WIFI_PASS
    string "WiFi password"
    default ""
    help
        Password for CLAWLEXA_WIFI_SSID (WPA2). Leave empty for an open network.
        Stored only in your local (gitignored) sdkconfig.

config CLAWLEXA_BRIDGE_HOST
    string "Bridge host (IP or hostname)"
    default ""
    help
        Host running clawlexa-bridge. The device dials ws://<host>:<port>. Set
        to the bridge laptop's LAN IP. Empty = don't connect to the bridge.

config CLAWLEXA_BRIDGE_PORT
    int "Bridge port"
    default 8765
    help
        TCP port clawlexa-bridge listens on (default 8765).

config CLAWLEXA_STREAM_MIC_ON_CONNECT
    bool "Stream a few seconds of mic to the bridge on connect"
    default n
    help
        Once connected to the bridge, stream a short mic recording over the
        WebSocket (the bridge saves it as a WAV). Phase 2c bring-up behavior —
        off by default; enable to exercise the device->bridge audio path.

endmenu
```

## firmware/sdkconfig.defaults
```kconfig
# Defaults applied on top of board-specific sdkconfig.defaults.esp32s3.
# Anything *board-independent* goes here.

# Use main task on its own stack with sane size for our future audio + LVGL needs.
CONFIG_ESP_MAIN_TASK_STACK_SIZE=8192

# Sensible log defaults — INFO at runtime, but allow VERBOSE if rebuilt.
CONFIG_LOG_DEFAULT_LEVEL_INFO=y
CONFIG_LOG_MAXIMUM_LEVEL_VERBOSE=y

# Compiler: optimize for size by default; debug builds can override.
CONFIG_COMPILER_OPTIMIZATION_SIZE=y

# Stack-smashing protection on (cheap insurance).
CONFIG_COMPILER_STACK_CHECK_MODE_STRONG=y

# Newlib: use nano formatting (smaller, no float by default — flip on when we need it).
CONFIG_NEWLIB_NANO_FORMAT=y
```

## firmware/sdkconfig.defaults.esp32s3
```kconfig
# Board-specific defaults for Waveshare ESP32-S3-Touch-LCD-1.85C.
# ESP32-S3R8 = 8 MB octal PSRAM, 16 MB flash.

CONFIG_IDF_TARGET="esp32s3"

# Flash: 16 MB QIO @ 80 MHz.
CONFIG_ESPTOOLPY_FLASHSIZE_16MB=y
CONFIG_ESPTOOLPY_FLASHMODE_QIO=y
CONFIG_ESPTOOLPY_FLASHFREQ_80M=y

# PSRAM: octal 8 MB on the S3R8.
CONFIG_SPIRAM=y
CONFIG_SPIRAM_MODE_OCT=y
CONFIG_SPIRAM_SPEED_80M=y
# Let dynamic allocations spill into PSRAM when internal RAM is tight.
CONFIG_SPIRAM_USE_MALLOC=y
CONFIG_SPIRAM_TRY_ALLOCATE_WIFI_LWIP=y

# CPU at 240 MHz — we'll have headroom for audio + display.
CONFIG_ESP_DEFAULT_CPU_FREQ_MHZ_240=y

# Custom partition table (see partitions.csv) — we want a big app slot + room for ML models.
CONFIG_PARTITION_TABLE_CUSTOM=y
CONFIG_PARTITION_TABLE_CUSTOM_FILENAME="partitions.csv"
```
